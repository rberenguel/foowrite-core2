## sdkconfig.defaults
```kconfig
# M5Stack Core2 — ESP32 (WROVER module, 16MB flash, 8MB PSRAM)
CONFIG_ESPTOOLPY_FLASHSIZE_16MB=y
CONFIG_ESPTOOLPY_FLASHSIZE="16mb"
CONFIG_ESPTOOLPY_FLASHMODE_DIO=y
CONFIG_ESPTOOLPY_FLASHFREQ_80M=y

# PSRAM
CONFIG_ESP32_SPIRAM_SUPPORT=y
CONFIG_SPIRAM_TYPE_AUTO=y
CONFIG_SPIRAM_SPEED_80M=y
CONFIG_SPIRAM_BOOT_INIT=y
CONFIG_SPIRAM_USE_MALLOC=y

# Partition table — use the custom one when we add it
# CONFIG_PARTITION_TABLE_CUSTOM=y
# CONFIG_PARTITION_TABLE_CUSTOM_FILENAME="partitions.csv"

# FreeRTOS tick rate — 100Hz is sufficient; 1kHz prevents light-sleep and wastes power
CONFIG_FREERTOS_HZ=100

# CPU frequency — 80MHz is more than sufficient for BLE HID + text rendering
CONFIG_ESP_DEFAULT_CPU_FREQ_MHZ_80=y
CONFIG_ESP_DEFAULT_CPU_FREQ_MHZ=80

# Stack sizes
CONFIG_ESP_MAIN_TASK_STACK_SIZE=8192

# Logging
CONFIG_LOG_DEFAULT_LEVEL_INFO=y

# I2C
CONFIG_I2C_ENABLE_DEBUG_LOG=n

# Bluetooth — NimBLE HID host (Central role)
CONFIG_BT_ENABLED=y
CONFIG_BT_NIMBLE_ENABLED=y
CONFIG_BT_NIMBLE_LOG_LEVEL_WARNING=y
CONFIG_BT_NIMBLE_LOG_LEVEL=2
CONFIG_BT_NIMBLE_ROLE_CENTRAL=y
CONFIG_BT_NIMBLE_ROLE_OBSERVER=y
CONFIG_BT_NIMBLE_MAX_CONNECTIONS=1
CONFIG_BT_NIMBLE_PINNED_TO_CORE_0=y
CONFIG_BT_NIMBLE_TASK_STACK_SIZE=4096
CONFIG_BT_NIMBLE_HOST_TASK_STACK_SIZE=4096

# FATFS Long File Name support
CONFIG_FATFS_LFN_HEAP=y
CONFIG_FATFS_MAX_LFN=255
```

## sdkconfig.defaults.esp32s3
```kconfig
# sdkconfig defaults for ESP32-S3 (Waveshare ESP32-S3-Touch-LCD-3.49)
# Auto-loaded by ESP-IDF when target is set to esp32s3.

# Flash
CONFIG_ESPTOOLPY_FLASHSIZE_8MB=y
CONFIG_PARTITION_TABLE_SINGLE_APP_LARGE=y

# PSRAM — ESP32-S3R8 has 8 MB Octal SPI PSRAM
CONFIG_ESP32S3_SPIRAM_SUPPORT=y
CONFIG_SPIRAM_MODE_OCT=y
CONFIG_SPIRAM_SPEED_80M=y
CONFIG_SPIRAM_USE_MALLOC=y
CONFIG_SPIRAM_MALLOC_ALWAYSINTERNAL=4096

# CPU — 240 MHz for BLE + display
CONFIG_ESP32S3_DEFAULT_CPU_FREQ_240=y

# Bluetooth (NimBLE)
CONFIG_BT_ENABLED=y
CONFIG_BT_NIMBLE_ENABLED=y

# Console — use the built-in USB Serial/JTAG controller (not USB OTG CDC).
# rsvpnano uses USB OTG for mass-storage which silences the serial port;
# foowrite does not use USB OTG so Serial/JTAG is always available.
CONFIG_ESP_CONSOLE_USB_SERIAL_JTAG=y
CONFIG_ESP_CONSOLE_USB_CDC=n
```
